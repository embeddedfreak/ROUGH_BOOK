

hdmi_tx: hdmitx@a0002000 {
	status = "okay";
	compatible = "xlnx,hdmi_tx-1.0";
	reg = <0x0 0xa0002000 0x0 0x10000>;
	clock = <&misc_clock>;
	xlnx,bridge = <&csc>;
};

display: disp_controller@a0000000 {
	status = "okay";
	compatible = "xlnx,display-controler";
	reg = <0x0 0xa0000000 0x0 0x01000>;
	interrupt = <0 80 4>;
	xlnx,bride = <&hdmi_tx>;
};

